/ {
    chosen {
        zmk,display = &oled;
    };

    oled_display {
        compatible = "zmk,oled-display";
        display = <&oled>;
        label = "oled_display";

        info {
            compatible = "zmk,oled-info";
        };
    };
};

