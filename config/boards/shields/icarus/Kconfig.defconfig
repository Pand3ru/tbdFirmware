## config/boards/shields/icarus/Kconfig.defconfig
```kconfig
if SHIELD_ICARUS_LEFT

config ZMK_KEYBOARD_NAME
  default "Icarus"

config ZMK_SPLIT_ROLE_CENTRAL
  default y

#config ZMK_WIDGET_BATTERY_STATUS
#  default y

#config ZMK_WIDGET_OUTPUT_STATUS
#  default y

endif

if SHIELD_ICARUS_LEFT || SHIELD_ICARUS_RIGHT

config ZMK_SPLIT
  default y

  if ZMK_DISPLAY
    config I2C
      default y

    config SSD1306
      default y
  endif 
endif
```
